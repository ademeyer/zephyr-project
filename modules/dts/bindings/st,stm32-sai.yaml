## modules/dts/bindings/st,stm32-sai.yaml
```yaml
# Copyright (c) 2025 Author. All Rights Reserved.
# SPDX-License-Identifier: Apache-2.0

description: |
STM32 I2S controller

It is present on stm32 devices such as STM32F7xxx and STM32F7xxx

compatible: "st,stm32-sai"

include: st,stm32-i2s.yaml

properties:
  block:
    type: int 
    description: |
      Indicate the block register of the SAI  
      Availble:
        - BLOCKA  
        - BLOCKB  

    enum:
      - BLOCKA
      - BLOCKB
```

## modules/say_hello/Kconfig
```kconfig
# Create a new option in menuconfig
config SAY_HELLO
	bool "basic print hello to the console"
	default n # Set the library to be disabled by default
	depends on PRINTK # it depends on printk function
	help
		Adds say_hello() function to print a basic message to the console
```

## modules/stm32f746_disco_sai/Kconfig
```kconfig
# STM32 SAI driver configuration options

# Copyright (c) 2018 STMicroelectronics
# SPDX-License-Identifier: Apache-2.0

menuconfig SAI_STM32
	bool "STM32 MCU SAI controller driver"
	default y
	# depends on DT_HAS_ST_STM32_SAI_ENABLED
	select CACHE_MANAGEMENT if CPU_HAS_DCACHE
	select DMA
	select PINCTRL
	# select SOC_SERIES_STM32F7X
	help
		Enable SAI support on the STM32F7 & STM32H7 family of processors.
		(Tested on STM32F7_Disco Board)

if SAI_STM32

config STM32_SAI_HAS_MCLK_CONFIG_OPTION
	bool "Set if SAI has MCLK configuration options"
	default n
	help
		Select this if the SAI IP allows configuration
		of the master clock. Master clock configuration
		refers to enabling/disabling the master clock,
		setting the signal as input or output or dividing
		the master clock output.

# config

config SAI_STM32_RX_BLOCK_COUNT
	int "RX queue length"
	default 4

config SAI_STM32_TX_BLOCK_COUNT
	int "TX queue length"
	default 4

endif # SAI_STM32
```

## modules/stm32f746_disco_sai/dts/bindings/st,stm32-sai.yaml
```yaml
# Copyright (c) 2025 Author. All Rights Reserved.
# SPDX-License-Identifier: Apache-2.0

description: STM32 SAI controller

compatible: "st,stm32-sai"

include: st,stm32-i2s-common.yaml

properties:
  block:
    type: int 
    description: |
      Indicate the block register of the SAI  
      Availble:
        - BLOCKA  
        - BLOCKB  

    enum:
      - BLOCKA
      - BLOCKB
```
